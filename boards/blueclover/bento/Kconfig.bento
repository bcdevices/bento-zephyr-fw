## boards/blueclover/bento/Kconfig.bento
```kconfig
# Copyright (c) 2026 Blue Clover Devices
# SPDX-License-Identifier: Apache-2.0

config BOARD_BENTO
	select SOC_RP2350B_M33 if BOARD_BENTO_RP2350B_M33
```

## boards/blueclover/bento/Kconfig.defconfig
```kconfig
# Copyright (c) 2026 Blue Clover Devices
# SPDX-License-Identifier: Apache-2.0

if BOARD_BENTO

config USB_SELF_POWERED
	default n

endif # BOARD_BENTO
```

## boards/blueclover/bento/board.yml
```yaml
board:
  name: bento
  full_name: Blue Clover Bento Demo Board (SUB-00156)
  vendor: blueclover
  socs:
  - name: rp2350b
```

## boards/blueclover/bento2/Kconfig.bento2
```kconfig
# Copyright (c) 2026 Blue Clover Devices
# SPDX-License-Identifier: Apache-2.0

config BOARD_BENTO2
	select SOC_RP2350B_M33 if BOARD_BENTO2_RP2350B_M33
```

## boards/blueclover/bento2/board.yml
```yaml
board:
  name: bento2
  full_name: Blue Clover Bento2 Demo Board (SUB-00156)
  vendor: blueclover
  socs:
  - name: rp2350b
```

## tests/usb_regression/testcase.yaml
```yaml
tests:
  bento.usb.regression:
    platform_allow:
      - native_sim
    integration_platforms:
      - native_sim
    tags: usb regression
```
