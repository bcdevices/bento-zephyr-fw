## CMakeLists.txt
```
# SPDX-License-Identifier: Apache-2.0

cmake_minimum_required(VERSION 3.20.0)

# Command transport, selected with -DBLINKY_SHELL=usb|uart (or
# `make blinky BLINKY_SHELL=...`). Both print the same `version` output, so
# test plans can parse either.
#
# - usb:  Zephyr shell over USB CDC-ACM (usb_shell.conf, usb_shell.overlay,
#         and usb_shell/<board>.conf if present). Needs a zephyr_udc0 USB
#         device controller. Default for boards with USB.
# - uart: minimal `version` command on the console UART (uart_console.conf,
#         src/blinky_uart_cmd.c). On a Nucleo the console is the ST-LINK
#         virtual COM port, so no second USB connection is needed.
#
# Boards in BLINKY_UART_ONLY_BOARDS have no USB device controller (or too
# little RAM for the shell) and always use uart.
set(BLINKY_UART_ONLY_BOARDS
  nucleo_l011k4   # STM32L011K4: no USB, 2 KB RAM
)
string(REGEX REPLACE "[/@].*" "" blinky_board "${BOARD}")
if(blinky_board IN_LIST BLINKY_UART_ONLY_BOARDS)
  set(blinky_shell_default uart)
else()
  set(blinky_shell_default usb)
endif()
set(BLINKY_SHELL ${blinky_shell_default} CACHE STRING "blinky command transport: usb or uart")
set_property(CACHE BLINKY_SHELL PROPERTY STRINGS usb uart)

if(BLINKY_SHELL STREQUAL "uart")
  list(APPEND EXTRA_CONF_FILE ${CMAKE_CURRENT_SOURCE_DIR}/uart_console.conf)
elseif(BLINKY_SHELL STREQUAL "usb")
  if(blinky_board IN_LIST BLINKY_UART_ONLY_BOARDS)
    message(FATAL_ERROR "blinky: ${blinky_board} has no USB shell support; use BLINKY_SHELL=uart")
  endif()
  list(APPEND EXTRA_CONF_FILE ${CMAKE_CURRENT_SOURCE_DIR}/usb_shell.conf)
  if(EXISTS ${CMAKE_CURRENT_SOURCE_DIR}/usb_shell/${blinky_board}.conf)
    list(APPEND EXTRA_CONF_FILE ${CMAKE_CURRENT_SOURCE_DIR}/usb_shell/${blinky_board}.conf)
  endif()
  list(APPEND EXTRA_DTC_OVERLAY_FILE ${CMAKE_CURRENT_SOURCE_DIR}/usb_shell.overlay)
else()
  message(FATAL_ERROR "blinky: BLINKY_SHELL must be usb or uart, not '${BLINKY_SHELL}'")
endif()
message(STATUS "blinky: BLINKY_SHELL=${BLINKY_SHELL}")

find_package(Zephyr REQUIRED HINTS $ENV{ZEPHYR_BASE})
project(bento_blinky)

# The app version lives in ./VERSION; Zephyr turns it into
# <zephyr/app_version.h>. APP_BUILD_VERSION in that header comes from
# `git describe` run in this directory, but the generated header is only
# rebuilt when its declared dependencies change. Without this the git
# description goes stale as soon as HEAD moves, so depend on the git index.
if(EXISTS ${CMAKE_CURRENT_SOURCE_DIR}/VERSION)
  find_package(Git QUIET)
  if(GIT_FOUND)
    # --path-format=absolute avoids the relative-path ambiguity of a bare
    # `--git-path` (which resolves against the CWD, not the repo root).
    execute_process(
      COMMAND ${GIT_EXECUTABLE} rev-parse --path-format=absolute --git-path index
      WORKING_DIRECTORY ${CMAKE_CURRENT_SOURCE_DIR}
      OUTPUT_VARIABLE app_git_index
      OUTPUT_STRIP_TRAILING_WHITESPACE
      ERROR_QUIET
      RESULT_VARIABLE app_git_index_rc
    )
    # Only add the dependency if the index actually exists: ninja treats a
    # missing dependency with no rule to build it as a hard error.
    if(app_git_index_rc EQUAL 0 AND EXISTS ${app_git_index})
      set_property(TARGET app_version_h PROPERTY APP_VERSION_DEPENDS ${app_git_index})
    endif()
  endif()
endif()

target_sources(app PRIVATE src/main.c)
if(CONFIG_SHELL)
  target_sources(app PRIVATE src/blinky_shell.c)
else()
  target_sources(app PRIVATE src/blinky_uart_cmd.c)
endif()
```

## prj.conf
```kconfig
# Common blinky settings.
#
# - Board-specific settings (LED backend, USB product string) live in
#   boards/<board>.conf, which Zephyr merges on top of this file.
# - The command transport is added by CMakeLists.txt: usb_shell.conf (Zephyr
#   shell over USB CDC-ACM) or, for boards without USB or enough RAM for the
#   shell, uart_console.conf (a minimal `version` command on the console UART).
# - Logging is configured in usb_shell.conf. The UART console transport is
#   for small parts and leaves it off; the boot banner and `version` use
#   printk(), which works either way.

CONFIG_GPIO=y
```

## uart_console.conf
```kconfig
# Minimal console command transport (src/blinky_uart_cmd.c), for boards
# without a USB device controller or the RAM for the Zephyr shell. Applied by
# CMakeLists.txt for boards in BLINKY_UART_CONSOLE_BOARDS.
#
# Reads lines from the console UART (zephyr,console) and answers `version`
# with the same output as the shell's `version` command.

CONFIG_SERIAL=y
CONFIG_UART_INTERRUPT_DRIVEN=y
```

## usb_shell.conf
```kconfig
# USB CDC-ACM shell, for boards with a USB device controller (zephyr_udc0).
# Applied by CMakeLists.txt together with usb_shell.overlay; boards listed in
# BLINKY_UART_CONSOLE_BOARDS get uart_console.conf instead.
#
# CONFIG_CDC_ACM_SERIAL_PRODUCT_STRING is set per board in boards/<board>.conf:
# this fragment is merged after the board file, so setting it here would
# override the board's value.

# Interactive shell, routed to a USB CDC-ACM serial port by ./app.overlay.
# The console stays on the board's physical UART (zephyr,console in the board
# DTS: &uart1 GP4/GP5 on Bento, &usart3 ST-LINK VCP on nucleo_f439zi; 115200
# 8N1), so logs and fault output survive a USB-side wedge.
CONFIG_SHELL=y
CONFIG_SHELL_PROMPT_UART="blinky:~$ "

# --- USB CDC-ACM shell transport -------------------------------------------
# These mirror app/prj.conf. Kept in sync deliberately, so that a USB problem
# reproduced on blinky is reproducing the same configuration the app uses --
# blinky is the lighter-weight vehicle for exercising the USB shell.

# The USB stack and the CDC-ACM instance are brought up automatically at boot,
# so no explicit usbd_enable() is needed in application code.
CONFIG_USB_DEVICE_STACK_NEXT=y
CONFIG_CDC_ACM_SERIAL_INITIALIZE_AT_BOOT=y
CONFIG_UART_LINE_CTRL=y

# Give CDC-ACM its own workqueue instead of the shared system workqueue, so
# USB TX servicing is not delayed behind other system-workqueue items.
CONFIG_USBD_CDC_ACM_WORKQUEUE=y
CONFIG_USBD_CDC_ACM_STACK_SIZE=2048

# Allow the device to ask a suspended host to resume it, which is the recovery
# rung in patch 0002 that preserves enumeration. Requires patch 0004 for the
# descriptor attribute itself.
CONFIG_CDC_ACM_SERIAL_REMOTE_WAKEUP=y

# NOTE: CONFIG_SHELL_BACKEND_SERIAL_CHECK_DTR is intentionally left OFF.
# With the DTR check enabled the shell suspends all TX whenever the host
# deasserts DTR; some hosts/terminals drop DTR transiently, which makes the
# shell appear to hang until DTR is reasserted.

# Shell TX ring buffer (defaults to 8 bytes, enough only for keystroke echo).
# Sized to hold a full `help` in one go, which keeps the shell out of
# shell_pend_on_txdone() in the common case.
CONFIG_SHELL_BACKEND_SERIAL_TX_RING_BUFFER_SIZE=8192

# Log output goes to the console (UART), NOT through the shell.
#
# With the shell on USB CDC-ACM, CONFIG_SHELL_LOG_BACKEND=y creates a feedback
# loop: a log record is written to the shell, the shell writes it to CDC-ACM,
# that drives USB TX, and anything logged on that path re-enters the shell.
# usbd_cdc_acm.c explicitly detects this topology (shell on cdc-acm + shell log
# backend) and force-disables its own logging to "prevent endless recursive
# logging loop" -- but that only severs the USB stack's own strand, not the
# application's.
#
# Keeping logs on the UART console breaks the loop entirely, and has the
# separate benefit that log output survives a USB wedge, which is exactly when
# it is most needed.
CONFIG_SHELL_LOG_BACKEND=n

# Compile out USB stack logging. These modules default to INFO, and the shell
# they would be reporting on is itself carried over USB -- so a USB fault logs
# through the transport that just faulted, and the log write re-enters the path
# being reported on. Off at compile time (not merely filtered at runtime) so no
# log call sites remain in the USB data path.
CONFIG_USBD_LOG_LEVEL_OFF=y

# CDC-ACM and the UDC driver keep warnings/errors, which land on the UART
# console (see CONFIG_SHELL_LOG_BACKEND=n above) and so remain readable even
# when the USB side is unhappy. Their INFO/DBG chatter stays out.
CONFIG_USBD_CDC_ACM_LOG_LEVEL_WRN=y
CONFIG_UDC_DRIVER_LOG_LEVEL_ERR=y

# --- Logging ---------------------------------------------------------------

CONFIG_LOG=y

# Logs go to the board's console UART (zephyr,console), not through the shell.
# Nothing else selects a log backend (the shell log backend is off in
# this file), so enable the UART one explicitly; otherwise LOG_* output
# is silently dropped.
CONFIG_LOG_BACKEND_UART=y

# Emit log records synchronously from the calling thread rather than queuing
# them for the log processing thread.
#
# Patch 0002 removes logging from the per-packet line-error paths in the UDC
# ISR, so this is no longer load-bearing for the USB hot path. It is kept
# because the logs that remain are the ones that report a fault -- link
# recovery, abort-handshake timeout, unhandled IRQ -- and a deferred record
# that never gets processed is indistinguishable from a record that was never
# emitted. Those are exactly the records worth paying for synchronously.
CONFIG_LOG_MODE_IMMEDIATE=y

# Send printk() straight to the console driver instead of through the log
# subsystem. CONFIG_LOG_PRINTK defaults to y, which routes printk() into the
# deferred log pipeline, so fault output would be queued behind the subsystem
# it is reporting on.
CONFIG_LOG_PRINTK=n
```

## boards/bento_rp2350b_m33.conf
```kconfig
# Bento (bento/rp2350b/m33) blinky settings, merged on top of ../prj.conf.

# WS2812 RGB LED via the PIO led_strip driver.
# CONFIG_WS2812_STRIP_RPI_PICO_PIO defaults y when the DT node is enabled.
CONFIG_LED_STRIP=y

# The led_strip driver logs at DBG on every strip update, which floods an
# interactive shell at 1 Hz. Compile it in at INFO instead.
CONFIG_LED_STRIP_LOG_LEVEL_INF=y

# Bento gates the RGB LED 5V rail through a boot-on regulator (relay_5v);
# the regulator subsystem must be enabled to power the LED.
CONFIG_REGULATOR=y

CONFIG_CDC_ACM_SERIAL_PRODUCT_STRING="Bento Blinky Shell"
```

## boards/nucleo_f439zi.conf
```kconfig
# NUCLEO-F439ZI blinky settings, merged on top of ../prj.conf.
#
# LED:     LD1 (green, PB0) via the led0 alias.
# Console: USART3 (PD8/PD9), the ST-LINK virtual COM port, 115200 8N1.
# Shell:   BLINKY_SHELL=usb (default): Zephyr shell over USB CDC-ACM on the
#          user USB connector CN13; see ../usb_shell/nucleo_f439zi.conf.
#          BLINKY_SHELL=uart: `version` on the ST-LINK VCP, as on the L011K4.

# No board-specific Kconfig needed.
```

## boards/nucleo_l011k4.conf
```kconfig
# NUCLEO-L011K4 blinky settings, merged on top of ../prj.conf and
# ../uart_console.conf.
#
# LED:      green user LED on PB3 (Arduino D13) via the led0 alias.
# Console:  USART2 (PA2/PA15), the ST-LINK virtual COM port, 115200 8N1.
# Commands: `version` on the console (no USB on the STM32L011, and 2 KB of
#           RAM is too little for the Zephyr shell).
```

## app.overlay
```dts
/*
 * Copyright (c) 2026 Blue Clover Devices
 *
 * SPDX-License-Identifier: Apache-2.0
 *
 * Define a USB CDC-ACM serial port and route the interactive shell to it,
 * mirroring app/app.overlay so blinky can be used as the lighter-weight
 * vehicle for exercising the USB shell.
 *
 * The filename matters: Zephyr auto-applies `app.overlay` from the
 * application source directory. A differently-named overlay is silently
 * ignored, which would leave the shell on the UART with a clean build.
 *
 * The console (zephyr,console) deliberately stays on the physical UART
 * (&uart1, GP4/GP5 = RP_TX1/RP_RX1, in the board DTS): keeping boot banners,
 * logs and any fault output on a transport that does not depend on USB
 * enumeration means a USB-side wedge is still diagnosable over the wire.
 *
 * To route the shell back to the physical UART, drop the chosen node below.
 */

/ {
	chosen {
		zephyr,shell-uart = &cdc_acm_uart0;
	};
};

&zephyr_udc0 {
	cdc_acm_uart0: cdc_acm_uart0 {
		compatible = "zephyr,cdc-acm-uart";
		tx-fifo-size = <8192>;
		rx-fifo-size = <1024>;
	};
};
```

## usb_shell.overlay
```dts
/*
 * Copyright (c) 2026 Blue Clover Devices
 *
 * SPDX-License-Identifier: Apache-2.0
 *
 * Define a USB CDC-ACM serial port and route the interactive shell to it,
 * mirroring app/app.overlay so blinky can be used as the lighter-weight
 * vehicle for exercising the USB shell.
 *
 * Applied by CMakeLists.txt (as an EXTRA_DTC_OVERLAY_FILE, alongside
 * usb_shell.conf) when BLINKY_SHELL=usb, the default for boards with USB.
 * The board's DTS must label its USB device controller zephyr_udc0 (Bento,
 * nucleo_f439zi, ...). A boards/<board>.overlay, if present, is applied too.
 *
 * The console (zephyr,console) deliberately stays on the board's physical UART
 * (Bento: &uart1, GP4/GP5 = RP_TX1/RP_RX1; nucleo_f439zi: &usart3, the
 * ST-LINK virtual COM port), as set in the board DTS: keeping boot banners,
 * logs and any fault output on a transport that does not depend on USB
 * enumeration means a USB-side wedge is still diagnosable over the wire.
 *
 * To route the shell back to the physical UART, drop the chosen node below.
 */

/ {
	chosen {
		zephyr,shell-uart = &cdc_acm_uart0;
	};
};

&zephyr_udc0 {
	cdc_acm_uart0: cdc_acm_uart0 {
		compatible = "zephyr,cdc-acm-uart";
		tx-fifo-size = <8192>;
		rx-fifo-size = <1024>;
	};
};
```

## src/main.c
```c
// SPDX-License-Identifier: Apache-2.0
//
// Copyright (c) 2026 Blue Clover Devices
//
// Blinky for the Bento demo board and other demo boards (e.g. Nucleo).
//
// The LED backend is chosen from the devicetree:
//
// - "led-strip" alias (Bento): drives the LTST-E683CEGBW WS2812-compatible
//   RGB LED through Zephyr's led_strip API, cycling through a few colors.
// - "led0" alias (most Zephyr boards, e.g. nucleo_f439zi LD1): toggles a
//   GPIO LED.
//
// Either way the LED changes state once per second.

#include <zephyr/kernel.h>
#include <zephyr/device.h>
#include <zephyr/devicetree.h>
#include <zephyr/logging/log.h>
#include <zephyr/sys/printk.h>

// Version macros (generated from ./VERSION; see the Versioning section of
// the top-level README) and the command transport. The version is logged at
// startup and is also available via the `version` command.
#include "blinky.h"

LOG_MODULE_REGISTER(blinky, LOG_LEVEL_INF);

#define BLINK_PERIOD_MS 1000

#if DT_HAS_ALIAS(led_strip)

#include <zephyr/drivers/led_strip.h>

#define STRIP_NODE DT_ALIAS(led_strip)
#define NUM_LEDS   DT_PROP(STRIP_NODE, chain_length)

static const struct device *const strip = DEVICE_DT_GET(STRIP_NODE);

static struct led_rgb pixels[NUM_LEDS];

struct color {
	uint8_t r, g, b;
	const char *name;
};

// Kept dim on purpose: the LTST-E683CEGBW is bright even at low values.
static const struct color colors[] = {
	{ 0x10, 0x00, 0x00, "RED" },
	{ 0x00, 0x10, 0x00, "GREEN" },
	{ 0x00, 0x00, 0x10, "BLUE" },
	{ 0x00, 0x00, 0x00, "OFF" },
};

static size_t color_idx;

static int led_init(void)
{
	LOG_INF("WS2812 led_strip blinky | %d LED(s)", NUM_LEDS);

	if (!device_is_ready(strip)) {
		LOG_ERR("LED strip device %s not ready", strip->name);
		return -ENODEV;
	}

	return 0;
}

static void led_step(void)
{
	const struct color *c = &colors[color_idx];
	int rc;

	// Drive every LED in the chain to the same color.
	for (size_t i = 0; i < NUM_LEDS; i++) {
		pixels[i] = (struct led_rgb){ .r = c->r, .g = c->g, .b = c->b };
	}

	rc = led_strip_update_rgb(strip, pixels, NUM_LEDS);
	if (rc) {
		LOG_ERR("led_strip_update_rgb failed: %d", rc);
	}

	color_idx = (color_idx + 1) % ARRAY_SIZE(colors);
}

#elif DT_HAS_ALIAS(led0)

#include <zephyr/drivers/gpio.h>

static const struct gpio_dt_spec led = GPIO_DT_SPEC_GET(DT_ALIAS(led0), gpios);

static int led_init(void)
{
	int rc;

	LOG_INF("GPIO blinky | led0 = %s pin %d", led.port->name, led.pin);

	if (!gpio_is_ready_dt(&led)) {
		LOG_ERR("LED GPIO %s not ready", led.port->name);
		return -ENODEV;
	}

	rc = gpio_pin_configure_dt(&led, GPIO_OUTPUT_INACTIVE);
	if (rc) {
		LOG_ERR("gpio_pin_configure_dt failed: %d", rc);
	}

	return rc;
}

static void led_step(void)
{
	int rc = gpio_pin_toggle_dt(&led);

	if (rc) {
		LOG_ERR("gpio_pin_toggle_dt failed: %d", rc);
	}
}

#else
#error "blinky needs a \"led-strip\" or \"led0\" devicetree alias"
#endif

int main(void)
{
	int rc;

	// printk rather than LOG_INF so the identity line also appears on small
	// boards built without the logging subsystem.
	printk("blinky %s (build %s) on %s\n", APP_VERSION_STRING,
	       BLINKY_XSTR(APP_BUILD_VERSION), CONFIG_BOARD_TARGET);

	rc = led_init();
	if (rc) {
		return rc;
	}

	rc = blinky_cmd_init();
	if (rc) {
		LOG_ERR("command transport init failed: %d", rc);
	}

	while (1) {
		led_step();
		blinky_cmd_wait(K_MSEC(BLINK_PERIOD_MS));
	}

	return 0;
}
```

## src/blinky.h
```c
// SPDX-License-Identifier: Apache-2.0
//
// Copyright (c) 2026 Blue Clover Devices
//
// Shared declarations for the blinky command transports.

#ifndef BLINKY_H_
#define BLINKY_H_

#include <zephyr/kernel.h>
#include <zephyr/version.h>
#include <zephyr/app_version.h>

// APP_BUILD_VERSION is generated as a bare token (the `git describe` output,
// unquoted), so it has to be stringified before it can be printed.
#define BLINKY_STR(s)  #s
#define BLINKY_XSTR(s) BLINKY_STR(s)

// `version` command output. Shared by the USB shell (blinky_shell.c) and the
// UART console command (blinky_uart_cmd.c) so test plans can parse either.
// Each line is printed with a trailing newline.
#define BLINKY_VERSION_LINES(PRINT)                                            \
	do {                                                                   \
		PRINT("app:    blinky %s", APP_VERSION_STRING);                \
		PRINT("build:  %s", BLINKY_XSTR(APP_BUILD_VERSION));           \
		PRINT("zephyr: %s", KERNEL_VERSION_STRING);                    \
		PRINT("board:  %s", CONFIG_BOARD_TARGET);                      \
	} while (0)

#define BLINKY_PROMPT "blinky:~$ "

#ifdef CONFIG_SHELL

// The Zephyr shell runs in its own thread; main only has to sleep.
static inline int blinky_cmd_init(void)
{
	return 0;
}

static inline void blinky_cmd_wait(k_timeout_t timeout)
{
	k_sleep(timeout);
}

#else

// Start receiving commands on the console UART.
int blinky_cmd_init(void);

// Sleep for `timeout`, handling any commands that arrive in the meantime.
void blinky_cmd_wait(k_timeout_t timeout);

#endif

#endif // BLINKY_H_
```

## src/blinky_shell.c
```c
// SPDX-License-Identifier: Apache-2.0

//
// Copyright (c) 2026 Blue Clover Devices
//

/*
 * blinky_shell.c - Version reporting over the shell.
 *
 * The shell lives on a USB CDC-ACM port (zephyr,shell-uart = &cdc_acm_uart0 in
 * ../usb_shell.overlay). Zephyr's built-in `kernel version` command reports the Zephyr
 * kernel version, not the application's, so the app version from ./VERSION is
 * exposed here as a separate `version` command. Its output is shared with the
 * UART console transport (blinky_uart_cmd.c) via BLINKY_VERSION_LINES.
 */

#include <zephyr/kernel.h>
#include <zephyr/shell/shell.h>

#include "blinky.h"

static int cmd_version(const struct shell *sh, size_t argc, char **argv)
{
	ARG_UNUSED(argc);
	ARG_UNUSED(argv);

#define PRINT_LINE(...) shell_print(sh, __VA_ARGS__)
	BLINKY_VERSION_LINES(PRINT_LINE);
#undef PRINT_LINE

	return 0;
}

SHELL_CMD_REGISTER(version, NULL, "Show application, Zephyr, and board versions",
		   cmd_version);
```

## src/blinky_uart_cmd.c
```c
// SPDX-License-Identifier: Apache-2.0

//
// Copyright (c) 2026 Blue Clover Devices
//

/*
 * blinky_uart_cmd.c - Minimal line-based commands on the console UART.
 *
 * Selected with BLINKY_SHELL=uart: for boards without a USB device controller,
 * or without the RAM for the Zephyr shell (e.g. STM32L011K4, 2 KB), and for
 * using a Nucleo's ST-LINK virtual COM port instead of a second USB cable.
 * Supports one command, `version`, whose output matches the shell's `version`
 * command (BLINKY_VERSION_LINES).
 *
 * The RX ISR echoes characters and assembles a line; on CR or LF it hands the
 * line to the main thread, which runs the command from blinky_cmd_wait()
 * between LED updates. Characters received while a command is running are
 * dropped. Output uses printk(), which goes straight to the console driver
 * (CONFIG_LOG_PRINTK=n).
 */

#include <string.h>

#include <zephyr/kernel.h>
#include <zephyr/device.h>
#include <zephyr/drivers/uart.h>
#include <zephyr/sys/printk.h>
#include <zephyr/sys/util.h>

#include "blinky.h"

#define LINE_MAX 32

static const struct device *const uart = DEVICE_DT_GET(DT_CHOSEN(zephyr_console));

static char rx_line[LINE_MAX];
static size_t rx_len;
static char cmd_line[LINE_MAX];
static atomic_t cmd_busy;
static K_SEM_DEFINE(cmd_sem, 0, 1);

static void rx_char(char c)
{
	if (c == '\r' || c == '\n') {
		// Ignore the LF of a CRLF pair, and anything while a command runs.
		if ((c == '\n' && rx_len == 0) || atomic_get(&cmd_busy)) {
			rx_len = 0;
			return;
		}
		uart_poll_out(uart, '\r');
		uart_poll_out(uart, '\n');
		memcpy(cmd_line, rx_line, rx_len);
		cmd_line[rx_len] = '\0';
		rx_len = 0;
		atomic_set(&cmd_busy, 1);
		k_sem_give(&cmd_sem);
		return;
	}

	if ((c == '\b' || c == 0x7f) && rx_len > 0) {
		rx_len--;
		uart_poll_out(uart, '\b');
		uart_poll_out(uart, ' ');
		uart_poll_out(uart, '\b');
		return;
	}

	if (c >= ' ' && c <= '~' && rx_len < LINE_MAX - 1) {
		rx_line[rx_len++] = c;
		uart_poll_out(uart, c);
	}
}

static void uart_isr(const struct device *dev, void *user_data)
{
	uint8_t c;

	ARG_UNUSED(user_data);

	while (uart_irq_update(dev) && uart_irq_rx_ready(dev)) {
		while (uart_fifo_read(dev, &c, 1) == 1) {
			rx_char((char)c);
		}
	}
}

#define PRINT_LINE(fmt, ...) printk(fmt "\n", ##__VA_ARGS__)

static void run_command(const char *line)
{
	if (strcmp(line, "version") == 0) {
		BLINKY_VERSION_LINES(PRINT_LINE);
	} else if (line[0] != '\0') {
		printk("%s: command not found (try: version)\n", line);
	}
	printk(BLINKY_PROMPT);
}

int blinky_cmd_init(void)
{
	int rc;

	if (!device_is_ready(uart)) {
		return -ENODEV;
	}

	rc = uart_irq_callback_set(uart, uart_isr);
	if (rc) {
		return rc;
	}

	uart_irq_rx_enable(uart);
	printk(BLINKY_PROMPT);

	return 0;
}

void blinky_cmd_wait(k_timeout_t timeout)
{
	k_timepoint_t end = sys_timepoint_calc(timeout);

	while (k_sem_take(&cmd_sem, sys_timepoint_timeout(end)) == 0) {
		run_command(cmd_line);
		atomic_set(&cmd_busy, 0);
	}
}
```
