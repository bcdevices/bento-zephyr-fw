## CMakeLists.txt
```
# SPDX-License-Identifier: Apache-2.0

cmake_minimum_required(VERSION 3.20.0)
find_package(Zephyr REQUIRED HINTS $ENV{ZEPHYR_BASE})
project(bento_demo_app)

# The app version lives in ./VERSION; Zephyr turns it into
# <zephyr/app_version.h>. APP_BUILD_VERSION in that header comes from
# `git describe` run in this directory, but the generated header is only
# rebuilt when its declared dependencies change. Without this the git
# description goes stale as soon as HEAD moves, so depend on the git index.
if(EXISTS ${CMAKE_CURRENT_SOURCE_DIR}/VERSION)
  find_package(Git QUIET)
  if(GIT_FOUND)
    # --path-format=absolute avoids the relative-path ambiguity of a bare
    # `--git-path` (which resolves against the CWD, not the repo root).
    execute_process(
      COMMAND ${GIT_EXECUTABLE} rev-parse --path-format=absolute --git-path index
      WORKING_DIRECTORY ${CMAKE_CURRENT_SOURCE_DIR}
      OUTPUT_VARIABLE app_git_index
      OUTPUT_STRIP_TRAILING_WHITESPACE
      ERROR_QUIET
      RESULT_VARIABLE app_git_index_rc
    )
    # Only add the dependency if the index actually exists: ninja treats a
    # missing dependency with no rule to build it as a hard error.
    if(app_git_index_rc EQUAL 0 AND EXISTS ${app_git_index})
      set_property(TARGET app_version_h PROPERTY APP_VERSION_DEPENDS ${app_git_index})
    endif()
  endif()
endif()

target_sources(app PRIVATE
  src/main.c
  src/app_buzzer.c
  src/rtttl.c
  src/app_sensor.c
  src/app_ledstrip.c
  src/app_shell.c
)
```

## sample.yaml
```
# SPDX-License-Identifier: Apache-2.0
sample:
  name: Bento Demo
tests:
  test:
    platform_allow: bento/rp2350b/m33
    tags: sensor pwm gpio
    depends_on: pwm spi gpio i2c
```

## prj.conf
```kconfig
CONFIG_STDOUT_CONSOLE=y
CONFIG_GPIO=y
CONFIG_I2C=y
CONFIG_SPI=y
CONFIG_SENSOR=y
CONFIG_BME280=y
CONFIG_PWM=y
CONFIG_LED_STRIP=y
CONFIG_REGULATOR=y
CONFIG_ADC=y

# Floating point printf for sensor readings in shell output.
CONFIG_CBPRINTF_FP_SUPPORT=y

# Interactive shell and built-in per-subsystem shell modules.
CONFIG_SHELL=y
CONFIG_SHELL_PROMPT_UART="bento:~$ "
CONFIG_GPIO_SHELL=y
CONFIG_I2C_SHELL=y
CONFIG_SPI_SHELL=y
CONFIG_SENSOR_SHELL=y
CONFIG_ADC_SHELL=y

# Route the shell to a USB CDC-ACM serial port. The USB stack and the
# CDC-ACM instance are brought up automatically at boot, so no explicit
# usbd_enable() is needed in application code.
CONFIG_USB_DEVICE_STACK_NEXT=y
CONFIG_CDC_ACM_SERIAL_INITIALIZE_AT_BOOT=y
CONFIG_CDC_ACM_SERIAL_PRODUCT_STRING="Bento Peripheral Shell"
CONFIG_UART_LINE_CTRL=y

# Give CDC-ACM its own workqueue instead of the shared system workqueue, so
# USB TX servicing is not delayed behind other system-workqueue items.
CONFIG_USBD_CDC_ACM_WORKQUEUE=y
CONFIG_USBD_CDC_ACM_STACK_SIZE=2048

# NOTE: USB stack logging is deliberately NOT configured here.
#
# CONFIG_LOG is off in this app, so nothing in the USB path logs anyway. Setting
# CONFIG_USBD_LOG_LEVEL_OFF / CONFIG_USBD_CDC_ACM_LOG_LEVEL_OFF /
# CONFIG_UDC_DRIVER_LOG_LEVEL_OFF is not merely redundant, it warns: the log
# level symbols are Kconfig *choices* that only exist when CONFIG_LOG=y, so
# selecting them yields "was selected (set =y), but no symbol ended up as the
# choice selection" on every configure.
#
# If CONFIG_LOG is ever turned on to debug something unrelated, set those three
# to OFF at the same time. The shell here is carried over USB, so logging in the
# USB path would report a USB fault through the transport that just faulted.

# NOTE: CONFIG_SHELL_BACKEND_SERIAL_CHECK_DTR is intentionally left OFF.
# With the DTR check enabled the shell suspends all TX whenever the host
# deasserts DTR; some hosts/terminals drop DTR transiently, which makes the
# shell appear to hang (CPU healthy-idle, USB still enumerated, no output)
# until DTR is reasserted. Leaving it off keeps the shell sending regardless
# of host DTR state, which is far more reliable for an interactive test shell.

# Shell TX ring buffer (defaults to 8 bytes, enough only for keystroke echo).
# The bulk of a command's output is buffered in the CDC-ACM virtual UART
# TX FIFO (sized via tx-fifo-size in app.overlay); this just needs to be
# comfortably larger than the default.
CONFIG_SHELL_BACKEND_SERIAL_TX_RING_BUFFER_SIZE=512

# Longest command line the shell accepts (default 256). "bento buzzer play"
# takes a whole RTTTL tune as one argument; 512 fits roughly 100 notes.
CONFIG_SHELL_CMD_BUFF_SIZE=512

# Shell RX ring buffer (default 64). When it is full the serial backend's RX
# handler DROPS bytes (shell_uart.c, uart_rx_handle()). A host sending a long
# command in one burst can fill 64 bytes before the shell thread drains them,
# so keep this at least as large as the command buffer.
CONFIG_SHELL_BACKEND_SERIAL_RX_RING_BUFFER_SIZE=512

# PL022 SPI in interrupt mode. The default synchronous mode busy-polls the
# RX FIFO with no timeout, so a device that never clocks a response (e.g. a
# BME280 that is unpowered or mis-wired) hangs the calling thread FOREVER --
# and if that thread is the shell, the whole USB shell freezes. Interrupt
# mode waits on a completion semaphore with a length-derived timeout and
# returns -ETIMEDOUT instead, keeping the shell alive no matter what the
# peripheral does.
CONFIG_SPI_PL022_INTERRUPT=y
```

## app.overlay
```dts
/*
 * Copyright (c) 2026 Blue Clover Devices
 *
 * SPDX-License-Identifier: Apache-2.0
 *
 * Define a USB CDC-ACM serial port so the board can also be exercised over
 * USB. The interactive shell and console both live on the physical UART
 * (zephyr,console / zephyr,shell-uart = &uart1, GP4/GP5 = RP_TX1/RP_RX1,
 * in the board DTS); this node is left available for application use.
 *
 * To route the shell back over USB instead, restore:
 *     / { chosen { zephyr,shell-uart = &cdc_acm_uart0; }; };
 */

&zephyr_udc0 {
	cdc_acm_uart0: cdc_acm_uart0 {
		compatible = "zephyr,cdc-acm-uart";
		tx-fifo-size = <8192>;
		rx-fifo-size = <1024>;
	};
};
```

## src/main.c
```c
// SPDX-License-Identifier: Apache-2.0

//
// Copyright (c) 2019-2026 Blue Clover Devices
//

/* main.c - Application main entry point */

#include <zephyr/kernel.h>

#include "app_buzzer.h"
#include "app_sensor.h"
#include "app_ledstrip.h"

/*
 * Peripherals are exercised interactively through the USB CDC-ACM shell
 * (see app_shell.c and app.overlay). main() just brings the drivers up and
 * gives a brief visual power-on indication; the shell runs on its own backend
 * thread and waits for a host to open the USB serial port.
 */
int main(void)
{
	int err;

	err = app_sensor_environmental_setup();
	if (err) {
		printk("app_sensor_environmental_setup() failed, err=%d\n", err);
	}

	err = app_buzzer_setup();
	if (err) {
		printk("app_buzzer_setup() failed, err=%d\n", err);
	}

	err = app_ledstrip_setup();
	if (err) {
		printk("app_ledstrip_setup() failed, err=%d\n", err);
	}

	app_ledstrip_set_rgb(0x00, 0x1f, 0x00);

	printk("Bento peripheral shell ready. Connect over USB serial.\n");

	return 0;
}
```

## src/app_buzzer.c
```c
// SPDX-License-Identifier: Apache-2.0

//
// Copyright (c) 2019-2026 Blue Clover Devices
//

/* app_buzzer.c - Buzzer interface via PWM on RP2350B */

#include <zephyr/kernel.h>
#include <zephyr/device.h>
#include <zephyr/drivers/pwm.h>
#include <zephyr/sys/util.h>

#include "app_buzzer.h"

/*
 * Buzzer AUDIO_IN is on GP30, which the board DTS muxes as PWM slice 7,
 * side A (pwm_ch7a_default). The RP2350 PWM cells are addressed as:
 * channel_A = slice*2, channel_B = slice*2+1, so slice 7 side A = 14.
 *
 * (The previous value 13 = slice 6B / GP29 was never pinned out on this
 * board, so pwm_set() succeeded but drove no connected pin -- silent.)
 */
#define BUZZER_PWM_NODE DT_ALIAS(pwm_buzzer)
#define BUZZER_PWM_CHANNEL 14

/* Startup note-sweep timing: per-note tone length and inter-note gap. */
#define SWEEP_NOTE_MS  120U
#define PAUSE_DURATION K_MSEC(40)

/* Tune playback: silent gap at the end of each note, 1/10 of it, capped. */
#define NOTE_GAP_DIVISOR 10U
#define NOTE_GAP_MAX_MS  30U

static const struct device *const buzzer_pwm = DEVICE_DT_GET(BUZZER_PWM_NODE);

static const uint32_t note_freqs_hz[] = {
	988,         /* B */
	880,         /* A */
	784,         /* G */
	699,         /* F */
	659,         /* E */
	587,         /* D */
	523,         /* C */
};

int app_buzzer_setup(void)
{
	if (!device_is_ready(buzzer_pwm)) {
		printk("Buzzer PWM device not ready\n");
		return -ENODEV;
	}

	return 0;
}

/* Start a 50% duty tone. Leaves the PWM running until tone_off(). */
static int tone_on(uint32_t freq_hz)
{
	uint32_t period_us = 1000000U / freq_hz;
	int rc;

	rc = pwm_set(buzzer_pwm, BUZZER_PWM_CHANNEL,
		     PWM_USEC(period_us), PWM_USEC(period_us / 2U), 0);
	if (rc) {
		printk("Buzzer PWM set failed: %d\n", rc);
	}
	return rc;
}

static int tone_off(uint32_t freq_hz)
{
	return pwm_set(buzzer_pwm, BUZZER_PWM_CHANNEL,
		       PWM_USEC(1000000U / freq_hz), 0, 0);
}

int app_buzzer_beep(uint32_t freq_hz, uint32_t duration_ms)
{
	int rc;

	if (!device_is_ready(buzzer_pwm)) {
		return -ENODEV;
	}

	if (freq_hz == 0U) {
		return -EINVAL;
	}

	rc = tone_on(freq_hz);
	if (rc) {
		return rc;
	}

	k_sleep(K_MSEC(duration_ms));

	return tone_off(freq_hz);
}

int app_buzzer_play(const struct rtttl_note *notes, size_t count)
{
	int rc;

	if (!device_is_ready(buzzer_pwm)) {
		return -ENODEV;
	}

	for (size_t i = 0; i < count; i++) {
		uint32_t ms = notes[i].duration_ms;
		uint32_t freq = notes[i].freq_hz;
		uint32_t gap;

		if (freq == 0U) {
			k_sleep(K_MSEC(ms));
			continue;
		}

		/*
		 * Cut each tone short by a small gap so repeated notes
		 * (e.g. "c,c") are heard as two notes, not one long one.
		 */
		gap = MIN(ms / NOTE_GAP_DIVISOR, NOTE_GAP_MAX_MS);

		rc = tone_on(freq);
		if (rc) {
			return rc;
		}
		k_sleep(K_MSEC(ms - gap));
		rc = tone_off(freq);
		if (rc) {
			return rc;
		}
		k_sleep(K_MSEC(gap));
	}

	return 0;
}

int app_buzzer_startup_sweep(void)
{
	int rc;

	if (!device_is_ready(buzzer_pwm)) {
		printk("Buzzer PWM device not ready\n");
		return -ENODEV;
	}

	for (int i = 0; i < ARRAY_SIZE(note_freqs_hz); i++) {
		rc = app_buzzer_beep(note_freqs_hz[i], SWEEP_NOTE_MS);
		if (rc) {
			return rc;
		}

		k_sleep(PAUSE_DURATION);
	}

	return 0;
}
```

## src/app_buzzer.h
```c
/* SPDX-License-Identifier: Apache-2.0 */

//
// Copyright (c) 2021-2026 Blue Clover Devices
//

#include <stddef.h>
#include <stdint.h>

#include "rtttl.h"

/*
 * @brief Verify the buzzer PWM device is ready.
 * @return 0 on success, non-zero on failure.
 */
int app_buzzer_setup(void);

/*
 * @brief Play the startup note sweep on the buzzer.
 * @return 0 on success, non-zero on failure.
 */
int app_buzzer_startup_sweep(void);

/*
 * @brief Sound the buzzer at a given frequency for a given duration.
 *
 * @param freq_hz   Tone frequency in Hz. Must be > 0.
 * @param duration_ms  How long to sound the tone, in milliseconds.
 * @return 0 on success, non-zero on failure.
 */
int app_buzzer_beep(uint32_t freq_hz, uint32_t duration_ms);

/*
 * @brief Play a parsed tune on the buzzer, blocking until it finishes.
 *
 * Notes with freq_hz == 0 are rests.
 *
 * @param notes  Notes to play, e.g. from rtttl_parse().
 * @param count  Number of notes.
 * @return 0 on success, non-zero on failure.
 */
int app_buzzer_play(const struct rtttl_note *notes, size_t count);
```

## src/app_ledstrip.c
```c
// SPDX-License-Identifier: Apache-2.0

//
// Copyright (c) 2019-2026 Blue Clover Devices
//

/*
 * app_ledstrip.c - WS2812 RGB LED control on the Bento board.
 *
 * Drives the LTST-E683CEGBW WS2812-compatible RGB LED through Zephyr's
 * WS2812 PIO led_strip driver via the "led-strip" devicetree alias. On
 * Bento the LED 5V rail is gated by the relay_5v boot-on regulator (so no
 * GPIO power-enable is needed here); the data pin is GPIO14 (low GPIO bank).
 */

#include <zephyr/kernel.h>
#include <zephyr/device.h>
#include <zephyr/drivers/led_strip.h>

#include "app_ledstrip.h"

#define STRIP_NODE DT_ALIAS(led_strip)
#define NUM_LEDS   DT_PROP(STRIP_NODE, chain_length)

static const struct device *const strip = DEVICE_DT_GET(STRIP_NODE);
static size_t ledstrip_counter;

static const struct led_rgb colors[] = {
	{ .r = 0x1f, .g = 0x00, .b = 0x00 },   /* red */
	{ .r = 0x00, .g = 0x1f, .b = 0x00 },   /* green */
	{ .r = 0x00, .g = 0x00, .b = 0x1f },   /* blue */
};

static struct led_rgb pixels[NUM_LEDS];

int app_ledstrip_setup(void)
{
	if (!device_is_ready(strip)) {
		printk("LED strip device %s not ready\n", strip->name);
		return -ENODEV;
	}

	ledstrip_counter = 0;

	return 0;
}

int app_ledstrip_run(void)
{
	const struct led_rgb *c = &colors[ledstrip_counter % ARRAY_SIZE(colors)];

	ledstrip_counter++;

	return app_ledstrip_set_rgb(c->r, c->g, c->b);
}

int app_ledstrip_set_rgb(uint8_t r, uint8_t g, uint8_t b)
{
	if (!device_is_ready(strip)) {
		return -ENODEV;
	}

	for (size_t i = 0; i < NUM_LEDS; i++) {
		pixels[i].r = r;
		pixels[i].g = g;
		pixels[i].b = b;
	}

	return led_strip_update_rgb(strip, pixels, NUM_LEDS);
}

int app_ledstrip_off(void)
{
	return app_ledstrip_set_rgb(0, 0, 0);
}
```

## src/app_ledstrip.h
```c
/* SPDX-License-Identifier: Apache-2.0 */

//
// Copyright (c) 2021-2026 Blue Clover Devices
//

#include <stdint.h>

int app_ledstrip_setup(void);

/*
 * @brief Advance the built-in color cycle by one step (red/green/blue).
 * @return 0 on success, non-zero on failure.
 */
int app_ledstrip_run(void);

/*
 * @brief Set every pixel to a fixed RGB color.
 * @return 0 on success, non-zero on failure.
 */
int app_ledstrip_set_rgb(uint8_t r, uint8_t g, uint8_t b);

/*
 * @brief Turn the LED strip off (all pixels black).
 * @return 0 on success, non-zero on failure.
 */
int app_ledstrip_off(void);
```

## src/app_sensor.c
```c
// SPDX-License-Identifier: Apache-2.0

//
// Copyright (c) 2019-2026 Blue Clover Devices
//

/* app_sensor.c - BME280 environmental sensor interface (SPI) */

#include <zephyr/kernel.h>
#include <zephyr/device.h>
#include <zephyr/drivers/sensor.h>

#include "app_sensor.h"

#define BME280_NODE DT_NODELABEL(bme280)

static const struct device *const bme280 = DEVICE_DT_GET(BME280_NODE);

/*
 * Readiness is a boot-time property: device_is_ready() reflects whether the
 * driver's init hook succeeded, and that result cannot change afterwards. It
 * is checked once in app_sensor_environmental_setup() and cached here rather
 * than re-tested on every read.
 */
static bool bme280_ready;

int app_sensor_environmental_read(struct sensor_value *temp,
				  struct sensor_value *hum,
				  struct sensor_value *press)
{
	int rc;

	if (!bme280_ready) {
		return -ENODEV;
	}

	rc = sensor_sample_fetch(bme280);
	if (rc != 0) {
		return rc;
	}

	rc = sensor_channel_get(bme280, SENSOR_CHAN_AMBIENT_TEMP, temp);
	if (rc != 0) {
		return rc;
	}

	rc = sensor_channel_get(bme280, SENSOR_CHAN_HUMIDITY, hum);
	if (rc != 0) {
		return rc;
	}

	return sensor_channel_get(bme280, SENSOR_CHAN_PRESS, press);
}

int app_sensor_environmental_setup(void)
{
	struct sensor_value temp, hum, press;
	int rc;

	if (!device_is_ready(bme280)) {
		printk("BME280 device not ready\n");
		return -ENODEV;
	}

	bme280_ready = true;

	rc = app_sensor_environmental_read(&temp, &hum, &press);
	if (rc != 0) {
		printk("BME280: read failed: %d\n", rc);
		return rc;
	}

	printk("BME280: %.2f C ; %.2f %%RH ; %.2f kPa\n",
	       sensor_value_to_double(&temp),
	       sensor_value_to_double(&hum),
	       sensor_value_to_double(&press));

	return 0;
}
```

## src/app_sensor.h
```c
/* SPDX-License-Identifier: Apache-2.0 */

//
// Copyright (c) 2021-2026 Blue Clover Devices
//

#include <zephyr/drivers/sensor.h>

/*
 * @brief Verify the BME280 is ready and print an initial reading.
 * @return 0 on success, non-zero on failure.
 */
int app_sensor_environmental_setup(void);

/*
 * @brief Fetch a fresh BME280 sample.
 *
 * @param temp   Out: ambient temperature (deg C).
 * @param hum    Out: relative humidity (%).
 * @param press  Out: pressure (kPa).
 * @return 0 on success, non-zero on failure.
 */
int app_sensor_environmental_read(struct sensor_value *temp,
				  struct sensor_value *hum,
				  struct sensor_value *press);
```

## src/app_shell.c
```c
// SPDX-License-Identifier: Apache-2.0

//
// Copyright (c) 2026 Blue Clover Devices
//

/*
 * app_shell.c - Board-specific shell commands for exercising Bento
 * peripherals over the USB CDC-ACM shell.
 *
 * Generic buses have their own built-in shell modules (gpio, i2c, spi,
 * sensor, adc). The commands here cover the board-specific peripherals
 * that lack a stock module: the PWM buzzer and the WS2812 RGB LED. They
 * are grouped under a "bento" root command.
 */

#include <stdlib.h>
#include <string.h>

#include <zephyr/kernel.h>
#include <zephyr/shell/shell.h>
#include <zephyr/drivers/sensor.h>

#include "app_buzzer.h"
#include "app_ledstrip.h"
#include "app_sensor.h"

/* ---- buzzer ------------------------------------------------------------ */

static int cmd_buzzer_beep(const struct shell *sh, size_t argc, char **argv)
{
	uint32_t freq_hz = 880U;
	uint32_t duration_ms = 200U;
	int rc;

	if (argc >= 2) {
		freq_hz = (uint32_t)strtoul(argv[1], NULL, 0);
	}
	if (argc >= 3) {
		duration_ms = (uint32_t)strtoul(argv[2], NULL, 0);
	}

	if (freq_hz == 0U) {
		shell_error(sh, "frequency must be > 0");
		return -EINVAL;
	}

	rc = app_buzzer_beep(freq_hz, duration_ms);
	if (rc) {
		shell_error(sh, "beep failed: %d", rc);
		return rc;
	}

	shell_print(sh, "beeped %u Hz for %u ms", freq_hz, duration_ms);
	return 0;
}

static int cmd_buzzer_sweep(const struct shell *sh, size_t argc, char **argv)
{
	int rc;

	ARG_UNUSED(argc);
	ARG_UNUSED(argv);

	rc = app_buzzer_startup_sweep();
	if (rc) {
		shell_error(sh, "sweep failed: %d", rc);
		return rc;
	}

	shell_print(sh, "sweep complete");
	return 0;
}

/*
 * Tunes built into the firmware, played by name ("bento buzzer play ode").
 * The first one is played when no argument is given.
 */
static const struct {
	const char *name;
	const char *rtttl;
} builtin_tunes[] = {
	/* "Twinkle, Twinkle, Little Star", first line (traditional). 14 notes, 8 s. */
	{ "twinkle", "twinkle:d=4,o=5,b=120:c,c,g,g,a,a,2g,f,f,e,e,d,d,2c" },
	/* Beethoven, "Ode to Joy", opening (public domain). 15 notes, 7 s. */
	{ "ode", "ode:d=4,o=5,b=140:e,e,f,g,g,f,e,d,c,c,d,e,e.,8d,2d" },
};

/* Resolve the play argument: RTTTL if it has a ':', else a built-in name. */
static const char *find_tune(const char *arg)
{
	if (arg == NULL) {
		return builtin_tunes[0].rtttl;
	}
	if (strchr(arg, ':') != NULL) {
		return arg;
	}
	for (size_t i = 0; i < ARRAY_SIZE(builtin_tunes); i++) {
		if (strcmp(arg, builtin_tunes[i].name) == 0) {
			return builtin_tunes[i].rtttl;
		}
	}
	return NULL;
}

/*
 * Parsed notes for "bento buzzer play". Static rather than on the shell
 * thread's stack; the shell runs one command at a time. A full command
 * line (CONFIG_SHELL_CMD_BUFF_SIZE) of the shortest notes ("c,") fits.
 */
#define TUNE_MAX_NOTES 256
static struct rtttl_note tune_notes[TUNE_MAX_NOTES];

static int cmd_buzzer_play(const struct shell *sh, size_t argc, char **argv)
{
	const char *tune = find_tune((argc >= 2) ? argv[1] : NULL);
	struct rtttl_error err = { 0 };
	int count;
	int rc;

	if (tune == NULL) {
		shell_error(sh, "unknown tune '%s'; built-in tunes:", argv[1]);
		for (size_t i = 0; i < ARRAY_SIZE(builtin_tunes); i++) {
			shell_error(sh, "  %s", builtin_tunes[i].name);
		}
		return -ENOENT;
	}

	/* Parse the whole tune first, so a bad string plays nothing. */
	count = rtttl_parse(tune, tune_notes, ARRAY_SIZE(tune_notes), &err);
	if (count < 0) {
		shell_error(sh, "bad rtttl: %s at char %u", err.msg,
			    (unsigned int)err.pos);
		return count;
	}

	rc = app_buzzer_play(tune_notes, (size_t)count);
	if (rc) {
		shell_error(sh, "play failed: %d", rc);
		return rc;
	}

	/* count includes pauses: every RTTTL entry is a note. */
	shell_print(sh, "played %d notes", count);
	return 0;
}

SHELL_STATIC_SUBCMD_SET_CREATE(sub_buzzer,
	SHELL_CMD_ARG(beep, NULL,
		"Sound the buzzer.\n"
		"Usage: bento buzzer beep [freq_hz] [duration_ms]",
		cmd_buzzer_beep, 1, 2),
	SHELL_CMD(sweep, NULL, "Play the startup note sweep.", cmd_buzzer_sweep),
	SHELL_CMD_ARG(play, NULL,
		"Play a tune; blocks until it finishes.\n"
		"Usage: bento buzzer play [twinkle | ode | \"<rtttl>\"]\n"
		"  <rtttl>  e.g. \"name:d=4,o=5,b=120:c,d,e\" (quote it)\n"
		"With no argument, plays twinkle.\n"
		"Prints \"played <n> notes\"; n counts pauses (p) too.",
		cmd_buzzer_play, 1, 1),
	SHELL_SUBCMD_SET_END
);

/* ---- ledstrip ---------------------------------------------------------- */

static int cmd_ledstrip_set(const struct shell *sh, size_t argc, char **argv)
{
	unsigned long r, g, b;
	int rc;

	r = strtoul(argv[1], NULL, 0);
	g = strtoul(argv[2], NULL, 0);
	b = strtoul(argv[3], NULL, 0);

	if (r > 255 || g > 255 || b > 255) {
		shell_error(sh, "each channel must be 0..255");
		return -EINVAL;
	}

	rc = app_ledstrip_set_rgb((uint8_t)r, (uint8_t)g, (uint8_t)b);
	if (rc) {
		shell_error(sh, "set failed: %d", rc);
		return rc;
	}

	shell_print(sh, "ledstrip set to %lu,%lu,%lu", r, g, b);
	return 0;
}

static int cmd_ledstrip_off(const struct shell *sh, size_t argc, char **argv)
{
	int rc;

	ARG_UNUSED(argc);
	ARG_UNUSED(argv);

	rc = app_ledstrip_off();
	if (rc) {
		shell_error(sh, "off failed: %d", rc);
		return rc;
	}

	shell_print(sh, "ledstrip off");
	return 0;
}

SHELL_STATIC_SUBCMD_SET_CREATE(sub_ledstrip,
	SHELL_CMD_ARG(set, NULL,
		"Set every pixel to an RGB color.\n"
		"Usage: bento ledstrip set <r> <g> <b>   (0..255 each)",
		cmd_ledstrip_set, 4, 0),
	SHELL_CMD(off, NULL, "Turn the LED strip off.", cmd_ledstrip_off),
	SHELL_SUBCMD_SET_END
);

/* ---- sensor ------------------------------------------------------------ */

static int cmd_sensor_read(const struct shell *sh, size_t argc, char **argv)
{
	struct sensor_value temp, hum, press;
	int rc;

	ARG_UNUSED(argc);
	ARG_UNUSED(argv);

	rc = app_sensor_environmental_read(&temp, &hum, &press);
	if (rc) {
		shell_error(sh, "read failed: %d", rc);
		return rc;
	}

	shell_print(sh, "temp: %.2f C", sensor_value_to_double(&temp));
	shell_print(sh, "hum:  %.2f %%RH", sensor_value_to_double(&hum));
	shell_print(sh, "pres: %.2f kPa", sensor_value_to_double(&press));
	return 0;
}

SHELL_STATIC_SUBCMD_SET_CREATE(sub_sensor,
	SHELL_CMD(read, NULL, "Read the BME280 (temp/humidity/pressure).",
		  cmd_sensor_read),
	SHELL_SUBCMD_SET_END
);

/* ---- root -------------------------------------------------------------- */

SHELL_STATIC_SUBCMD_SET_CREATE(sub_bento,
	SHELL_CMD(buzzer, &sub_buzzer, "Buzzer (PWM) commands.", NULL),
	SHELL_CMD(ledstrip, &sub_ledstrip, "WS2812 RGB LED commands.", NULL),
	SHELL_CMD(sensor, &sub_sensor, "BME280 environmental sensor commands.",
		  NULL),
	SHELL_SUBCMD_SET_END
);

SHELL_CMD_REGISTER(bento, &sub_bento, "Bento board peripheral commands", NULL);
```

## src/rtttl.c
```c
// SPDX-License-Identifier: Apache-2.0

//
// Copyright (c) 2026 Blue Clover Devices
//

/* rtttl.c - RTTTL parser. See rtttl.h for the accepted grammar. */

#include <errno.h>
#include <stdbool.h>

#include "rtttl.h"

#define DEFAULT_DURATION 4U
#define DEFAULT_OCTAVE   6U
#define DEFAULT_BPM      63U

#define MIN_OCTAVE 1U
#define MAX_OCTAVE 8U
#define MIN_BPM    25U
#define MAX_BPM    900U

/*
 * Octave-8 pitches in centi-Hz (C8 = 4186.01 Hz ... B8 = 7902.13 Hz), indexed
 * by semitone above C. Lower octaves are derived by halving, which keeps
 * rounding error below 0.5 Hz across the whole range.
 */
static const uint32_t octave8_centihz[12] = {
	418601, 443492, 469864, 497803, 527404, 558765,
	591991, 627193, 664488, 704000, 745862, 790213,
};

struct cursor {
	const char *base;
	const char *p;
};

static void skip_ws(struct cursor *c)
{
	while (*c->p == ' ' || *c->p == '\t' || *c->p == '\r' || *c->p == '\n') {
		c->p++;
	}
}

static char lower(char ch)
{
	return (ch >= 'A' && ch <= 'Z') ? (char)(ch - 'A' + 'a') : ch;
}

static bool is_digit(char ch)
{
	return ch >= '0' && ch <= '9';
}

static int fail(const struct cursor *c, struct rtttl_error *err, const char *msg)
{
	if (err != NULL) {
		err->pos = (size_t)(c->p - c->base);
		err->msg = msg;
	}
	return -EINVAL;
}

/* Read an unsigned decimal number. Returns false if there are no digits. */
static bool read_uint(struct cursor *c, uint32_t *out)
{
	uint32_t v = 0;

	if (!is_digit(*c->p)) {
		return false;
	}
	while (is_digit(*c->p)) {
		/* Saturate rather than overflow; range checks reject it later. */
		if (v < 100000U) {
			v = v * 10U + (uint32_t)(*c->p - '0');
		}
		c->p++;
	}
	*out = v;
	return true;
}

static bool valid_duration(uint32_t d)
{
	return d == 1U || d == 2U || d == 4U || d == 8U || d == 16U || d == 32U;
}

/* Semitone above C for a note letter, or -1 for a rest, -2 if invalid. */
static int note_semitone(char ch)
{
	switch (lower(ch)) {
	case 'c': return 0;
	case 'd': return 2;
	case 'e': return 4;
	case 'f': return 5;
	case 'g': return 7;
	case 'a': return 9;
	case 'b': /* fall through */
	case 'h': return 11;
	case 'p': return -1;
	default:  return -2;
	}
}

static uint16_t note_freq(int semitone, uint32_t octave)
{
	uint32_t shift = MAX_OCTAVE - octave;
	uint32_t centihz = octave8_centihz[semitone];

	if (shift > 0U) {
		centihz = (centihz + (1U << (shift - 1U))) >> shift;
	}
	return (uint16_t)((centihz + 50U) / 100U);
}

static int parse_defaults(struct cursor *c, struct rtttl_error *err,
			  uint32_t *dur, uint32_t *oct, uint32_t *bpm)
{
	skip_ws(c);
	if (*c->p == ':') {
		return 0; /* empty defaults section */
	}

	for (;;) {
		char key;
		uint32_t v;

		skip_ws(c);
		key = lower(*c->p);
		if (key != 'd' && key != 'o' && key != 'b') {
			return fail(c, err, "expected d=, o= or b= in defaults");
		}
		c->p++;
		skip_ws(c);
		if (*c->p != '=') {
			return fail(c, err, "expected '=' in defaults");
		}
		c->p++;
		skip_ws(c);
		if (!read_uint(c, &v)) {
			return fail(c, err, "expected a number in defaults");
		}

		if (key == 'd') {
			if (!valid_duration(v)) {
				return fail(c, err, "d must be 1, 2, 4, 8, 16 or 32");
			}
			*dur = v;
		} else if (key == 'o') {
			if (v < MIN_OCTAVE || v > MAX_OCTAVE) {
				return fail(c, err, "o must be 1-8");
			}
			*oct = v;
		} else {
			if (v < MIN_BPM || v > MAX_BPM) {
				return fail(c, err, "b must be 25-900");
			}
			*bpm = v;
		}

		skip_ws(c);
		if (*c->p == ',') {
			c->p++;
			continue;
		}
		if (*c->p == ':') {
			return 0;
		}
		return fail(c, err, "expected ',' or ':' after a default");
	}
}

int rtttl_parse(const char *str, struct rtttl_note *notes, size_t max_notes,
		struct rtttl_error *err)
{
	struct cursor c = { .base = str, .p = str };
	uint32_t def_dur = DEFAULT_DURATION;
	uint32_t def_oct = DEFAULT_OCTAVE;
	uint32_t bpm = DEFAULT_BPM;
	uint32_t whole_ms;
	size_t count = 0;
	int rc;

	if (str == NULL || notes == NULL || max_notes == 0U) {
		return fail(&c, err, "no input");
	}

	/* Name: everything up to the first ':'. */
	while (*c.p != '\0' && *c.p != ':') {
		c.p++;
	}
	if (*c.p != ':') {
		return fail(&c, err, "missing ':' after name");
	}
	c.p++;

	rc = parse_defaults(&c, err, &def_dur, &def_oct, &bpm);
	if (rc) {
		return rc;
	}
	c.p++; /* the ':' before the notes */

	whole_ms = (60000U * 4U) / bpm;

	for (;;) {
		uint32_t dur = def_dur;
		uint32_t oct = def_oct;
		uint32_t ms;
		bool dotted = false;
		int semi;

		skip_ws(&c);
		if (*c.p == '\0') {
			return (count == 0U) ? fail(&c, err, "no notes") :
					       fail(&c, err, "trailing ','");
		}

		if (is_digit(*c.p)) {
			if (!read_uint(&c, &dur) || !valid_duration(dur)) {
				return fail(&c, err,
					    "duration must be 1, 2, 4, 8, 16 or 32");
			}
		}

		semi = note_semitone(*c.p);
		if (semi == -2) {
			return fail(&c, err, "expected a note (a-g, h or p)");
		}
		c.p++;

		if (*c.p == '#') {
			if (semi < 0) {
				return fail(&c, err, "a pause cannot be sharp");
			}
			semi++;
			c.p++;
		}
		if (*c.p == '.') {
			dotted = true;
			c.p++;
		}
		if (is_digit(*c.p)) {
			(void)read_uint(&c, &oct);
			if (oct < MIN_OCTAVE || oct > MAX_OCTAVE) {
				return fail(&c, err, "octave must be 1-8");
			}
		}
		if (*c.p == '.' && !dotted) {
			dotted = true;
			c.p++;
		}

		/* b# wraps to c of the next octave. */
		if (semi == 12) {
			semi = 0;
			if (oct == MAX_OCTAVE) {
				return fail(&c, err, "note above b8");
			}
			oct++;
		}

		ms = whole_ms / dur;
		if (dotted) {
			ms += ms / 2U;
		}

		if (count == max_notes) {
			if (err != NULL) {
				err->pos = (size_t)(c.p - c.base);
				err->msg = "too many notes";
			}
			return -E2BIG;
		}
		notes[count].freq_hz = (semi < 0) ? 0U : note_freq(semi, oct);
		notes[count].duration_ms = (uint16_t)ms;
		count++;

		skip_ws(&c);
		if (*c.p == '\0') {
			return (int)count;
		}
		if (*c.p != ',') {
			return fail(&c, err, "expected ',' between notes");
		}
		c.p++;
	}
}
```

## src/rtttl.h
```c
/* SPDX-License-Identifier: Apache-2.0 */

//
// Copyright (c) 2026 Blue Clover Devices
//

/*
 * rtttl.h - RTTTL (Ring Tone Text Transfer Language) parser.
 *
 * Pure C with no Zephyr dependencies, so it can be unit-tested on the host
 * (see tests/rtttl).
 *
 * Format:  <name>:<defaults>:<notes>
 *   name      Any text without ':' (may be empty).
 *   defaults  Comma-separated d=<duration>, o=<octave>, b=<bpm>, in any
 *             order, any subset. Missing values use d=4, o=6, b=63.
 *   notes     Comma-separated [duration]<note>[#][.][octave][.]
 *             duration  1, 2, 4, 8, 16 or 32 (fraction of a whole note)
 *             note      a-g, h (= b), or p (pause/rest)
 *             #         sharp
 *             .         dotted (1.5x length); accepted before or after the
 *                       octave
 *             octave    1-8; c5 is 523 Hz (scientific pitch notation)
 *
 * Whitespace between tokens is ignored, and letters are case-insensitive.
 */

#ifndef RTTTL_H_
#define RTTTL_H_

#include <stddef.h>
#include <stdint.h>

/* One parsed note. freq_hz == 0 means a rest. */
struct rtttl_note {
	uint16_t freq_hz;
	uint16_t duration_ms;
};

/* Where and why a parse failed. pos is a byte offset into the input. */
struct rtttl_error {
	size_t pos;
	const char *msg;
};

/*
 * @brief Parse an RTTTL string into a note array.
 *
 * The whole string is validated before this returns, so a caller can reject
 * a malformed tune without playing any of it.
 *
 * @param str        NUL-terminated RTTTL string.
 * @param notes      Output array.
 * @param max_notes  Capacity of @p notes.
 * @param err        Optional; filled in on failure.
 * @return Number of notes (>= 1) on success, or a negative errno:
 *         -EINVAL for a malformed string, -E2BIG if it has more than
 *         @p max_notes notes.
 */
int rtttl_parse(const char *str, struct rtttl_note *notes, size_t max_notes,
		struct rtttl_error *err);

#endif /* RTTTL_H_ */
```
